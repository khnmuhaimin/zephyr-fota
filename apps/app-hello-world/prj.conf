## prj.conf
```kconfig
CONFIG_BOOTLOADER_MCUBOOT=y
CONFIG_LOG_MODE_IMMEDIATE=y
CONFIG_LOG=y
```

## boards/esp32-overlay.dts
```dts
/ {

	chosen {
		zephyr,console = &uart0;
		zephyr,shell-uart = &uart0;
	};
};

&uart0 {
	status = "okay";
};
```

## src/main.c
```c
/*
 * Copyright (c) 2012-2014 Wind River Systems, Inc.
 *
 * SPDX-License-Identifier: Apache-2.0
 */

#include <stdio.h>
#include <zephyr/logging/log.h>
LOG_MODULE_REGISTER(main, LOG_LEVEL_DBG);

int main(void)
{
    LOG_INF("Hello, New Image!");
    return 0;
}
```
