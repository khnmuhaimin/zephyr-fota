## apps/drivers/Kconfig
```kconfig
# Copyright (c) 2021 Nordic Semiconductor ASA
# SPDX-License-Identifier: Apache-2.0

menu "Drivers"
rsource "blink/Kconfig"
rsource "sensor/Kconfig"

# Stuff I added
rsource "modem/Kconfig"
# end stuff I added

endmenu
```

## apps/drivers/modem/Kconfig
```kconfig
# Copyright (c) 2021 Nordic Semiconductor ASA
# SPDX-License-Identifier: Apache-2.0

# if SENSOR
# rsource "example_sensor/Kconfig"
# endif # SENSOR

# Stuff I added
if MODEM
rsource "simcom-a76xx/Kconfig"
endif
# end stuff I added
```

## apps/drivers/modem/eee4022s_a76xx/Kconfig
```kconfig
menuconfig EEE4022S_A76XX
    bool "A76XX Modem Driver"
    depends on GPIO && UART_ASYNC_API
    select MODEM_CONTEXT
    select MODEM_CMD_HANDLER
    select MODEM_IFACE_UART
    select MODEM_SOCKET
    select NET_OFFLOAD
    select NET_SOCKETS_OFFLOAD
    help
      Enables the driver for the Simcom modems in the A76XX series.

if EEE4022S_A76XX

config EEE4022S_A76XX_INIT_PRIORITY
    int "Init priority"
    default 80
    help
      A76XX device driver initialization priority.

config EEE4022S_A76XX_APN
    string "APN"
    default "internet"
    help
      The Access Point Name for the cellular connection.


endif # EEE4022S_A76XX
```

## apps/drivers/modem/simcom-a76xx/Kconfig
```kconfig
config MODEM_A76XX
	bool "A76XX Driver"
	select MODEM_CONTEXT
	select MODEM_CMD_HANDLER
	select MODEM_IFACE_UART
	select MODEM_SOCKET
	select GPIO
	depends on NETWORKING
	help
	  Enables the driver for the A76XX series of modems.

if MODEM_A76XX

config MODEM_SIMCOM_A76XX_RX_STACK_SIZE
	int "Stack size for the simcom a76xx modem driver rx thread"
	default 1028
	help
	  This stack is used by the simcom A76XX RX thread.

config MODEM_SIMCOM_A76XX_RX_WORKQ_STACK_SIZE
	int "Stack size for the simcom a76xx modem driver work queue"
	default 2048
	help
		This stack is used by the work queue.

config MODEM_SIMCOM_A76XX_INIT_PRIORITY
	int "simcom a76xx driver init priority"
	default 80
	help
	  simcom a76xx driver initialization priority.

config MODEM_SIMCOM_A76XX_LTE_BANDS
	string "LTE bands the driver can use"
	default "8,20,28"
	help
		Comma separated list of usable lte bands.

config MODEM_SIMCOM_A76XX_APN
	string "APN for establishing a network connection"
	default "internet"
	help
	  This setting is used to set the APN name for the network connection
	  context. This value is specific to the network provider and may
	  need to be changed.

config MODEM_SIMCOM_A76XX_APN_MAX_LEN
    int "Maximum APN length"
    default 64
    help
      Sets the maximum size for the APN string buffer. This is used
      to safely allocate memory on the stack and prevent overflows.

choice MODEM_SIMCOM_A76XX_RAT
	bool "Radio Access Technology Mode"
	default MODEM_SIMCOM_A76XX_RAT_NB1

config MODEM_SIMCOM_A76XX_RAT_NB1
	bool "NB-IoT"
	help
		Enable LTE NB-IoT mode.

config MODEM_SIMCOM_A76XX_RAT_M1
	bool "Cat-M1"
	help
		Enable Cat-M1 mode.

config MODEM_SIMCOM_A76XX_RAT_GSM
	bool "GSM"
	help
	  Enable GSM mode.

endchoice

config MODEM_SIMCOM_A76XX_SOCKET_PRIORITY
	int "simcom a76xx socket offload priority"
	default NET_SOCKETS_PRIORITY_DEFAULT
	help
	  Sets the numerical priority for the Simcom A76XX socket offload implementation. A lower number means a higher priority, meaning it is checked earlier during socket creation.

endif # MODEM_A76XX
```

## apps/dts/bindings/modem/eee4022s,a76xx.yaml
```yaml
# Copyright (C) 2025 Olivier Lalonde
# SPDX-License-Identifier: Apache-2.0

description: Simcom A76XX modem

compatible: "eee4022s,a76xx"

include: uart-device.yaml
```

## apps/lib/wifi-initializer/Kconfig
```kconfig
config WIFI_INITIALIZER
	bool "Enable wifi initialization"
  	help
	 	 Enables initialization for wifi before the main function executes.

if WIFI_INITIALIZER

config WIFI_INITIALIZER_SSID
	string "SSID of the target AP"
	help
	  	SSID of the access point to connect to in station mode.
	  	For example: "TARGET-AP"

config WIFI_INITIALIZER_PASSWORD
	string "Pre-shared key for target AP"
	help
	  	WPA2 password used to connect to the target AP.
	  	For example: "PSK"

module = WIFI_INITIALIZER
source "subsys/logging/Kconfig.template.log_config"

endif
```

## build/Kconfig/Kconfig.modules
```kconfig
menu "apps (/home/khnmuhaimin/EEE4022S/zephyr-fota/apps)"
osource "/home/khnmuhaimin/EEE4022S/zephyr-fota/apps/Kconfig"
config ZEPHYR_APPS_MODULE
	bool
	default y
endmenu
menu "hal_espressif (/home/khnmuhaimin/EEE4022S/zephyr-fota/modules/hal/espressif)"
osource "/home/khnmuhaimin/EEE4022S/zephyr-fota/modules/hal/espressif/zephyr/Kconfig"
config ZEPHYR_HAL_ESPRESSIF_MODULE
	bool
	default y
	select TAINT_BLOBS

config ZEPHYR_HAL_ESPRESSIF_MODULE_BLOBS
	bool
	default y
endmenu
menu "mbedtls (/home/khnmuhaimin/EEE4022S/zephyr-fota/modules/crypto/mbedtls)"
osource "$(ZEPHYR_MBEDTLS_KCONFIG)"
config ZEPHYR_MBEDTLS_MODULE
	bool
	default y
endmenu
config ZEPHYR_MCUBOOT_MODULE
	bool
	default y
```

## build/Kconfig/Kconfig.shield.defconfig
```kconfig
osource "/home/khnmuhaimin/EEE4022S/zephyr-fota/apps/boards/shields/*/Kconfig.defconfig"
```

## build/Kconfig/Kconfig.sysbuild.modules
```kconfig
config ZEPHYR_APPS_MODULE
   bool
   default y
config ZEPHYR_HAL_ESPRESSIF_MODULE
   bool
   default y
config ZEPHYR_MBEDTLS_MODULE
   bool
   default y
config ZEPHYR_MCUBOOT_MODULE
   bool
   default y
```

## build/Kconfig/arch/Kconfig
```kconfig
# Load Zephyr Arch Kconfig descriptions.
osource "/home/khnmuhaimin/EEE4022S/zephyr-fota/zephyr/arch/rx/Kconfig"
osource "/home/khnmuhaimin/EEE4022S/zephyr-fota/zephyr/arch/x86/Kconfig"
osource "/home/khnmuhaimin/EEE4022S/zephyr-fota/zephyr/arch/xtensa/Kconfig"
osource "/home/khnmuhaimin/EEE4022S/zephyr-fota/zephyr/arch/sparc/Kconfig"
osource "/home/khnmuhaimin/EEE4022S/zephyr-fota/zephyr/arch/riscv/Kconfig"
osource "/home/khnmuhaimin/EEE4022S/zephyr-fota/zephyr/arch/posix/Kconfig"
osource "/home/khnmuhaimin/EEE4022S/zephyr-fota/zephyr/arch/mips/Kconfig"
osource "/home/khnmuhaimin/EEE4022S/zephyr-fota/zephyr/arch/arm64/Kconfig"
osource "/home/khnmuhaimin/EEE4022S/zephyr-fota/zephyr/arch/arm/Kconfig"
osource "/home/khnmuhaimin/EEE4022S/zephyr-fota/zephyr/arch/arc/Kconfig"
```

## build/Kconfig/boards/Kconfig
```kconfig
# Load Zephyr board Kconfig descriptions.
osource "/home/khnmuhaimin/EEE4022S/zephyr-fota/zephyr/boards/espressif/esp32_devkitc/Kconfig"
```

## build/Kconfig/boards/Kconfig.defconfig
```kconfig
# Load Zephyr board defconfig descriptions.
osource "/home/khnmuhaimin/EEE4022S/zephyr-fota/zephyr/boards/espressif/esp32_devkitc/Kconfig.defconfig"
```

## build/Kconfig/boards/Kconfig.esp32_devkitc
```kconfig
# Load board Kconfig descriptions.
osource "/home/khnmuhaimin/EEE4022S/zephyr-fota/zephyr/boards/espressif/esp32_devkitc/Kconfig.esp32_devkitc"
```
