## CMakeLists.txt
```
# SPDX-License-Identifier: Apache-2.0

cmake_minimum_required(VERSION 3.20.0)

find_package(Zephyr REQUIRED HINTS $ENV{ZEPHYR_BASE})
project(atttempt_2)

target_sources(app PRIVATE src/main.c)

# This application has its own Kconfig options.
set(KCONFIG_ROOT ${CMAKE_CURRENT_SOURCE_DIR}/Kconfig)

if(CONFIG_UPDATEHUB_DTLS)
    set(gen_dir ${ZEPHYR_BINARY_DIR}/include/generated/)

    foreach(inc_file
            servercert.der
            privkey.der
            )
        generate_inc_file_for_target(
            ${ZEPHYR_CURRENT_LIBRARY}
            src/certificates/${inc_file}
            ${gen_dir}/${inc_file}.inc
            )
    endforeach()
endif()
```

## prj.conf
```kconfig
# Wi-Fi Configuration
CONFIG_WIFI=y

# Network Configuration
CONFIG_NET_CONFIG_AUTO_INIT=n
CONFIG_NET_CONNECTION_MANAGER=y
CONFIG_NET_DHCPV4=y
CONFIG_NET_DHCPV4_SERVER=y
CONFIG_NET_IF_MAX_IPV4_COUNT=2
CONFIG_NET_IF_MAX_IPV6_COUNT=2
CONFIG_NET_IPV4=y
# CONFIG_NET_L2_ETHERNET=y  # disabled by overlay-wifi.conf
CONFIG_NET_L2_WIFI_MGMT=y
CONFIG_NET_MGMT=y
CONFIG_NET_MGMT_EVENT=y
CONFIG_NET_MGMT_EVENT_INFO=y
CONFIG_NET_MGMT_EVENT_QUEUE_SIZE=10
CONFIG_NET_MGMT_EVENT_STACK_SIZE=4096
CONFIG_NET_PKT_RX_COUNT=16
CONFIG_NET_PKT_TX_COUNT=16
CONFIG_NET_SOCKETS_SERVICE_STACK_SIZE=4096
CONFIG_NET_TCP=y
CONFIG_NET_UDP=y
CONFIG_NETWORKING=y

# Enable Shell
CONFIG_SHELL=y
CONFIG_SHELL_STACK_SIZE=8192
CONFIG_NET_SHELL=y

# LOG Configuration
CONFIG_NET_LOG=y
CONFIG_NET_DHCPV4_SERVER_LOG_LEVEL_DBG=y
CONFIG_LOG=y
CONFIG_NET_DHCPV4_LOG_LEVEL_DBG=y
CONFIG_NET_IPV4_LOG_LEVEL_DBG=y
CONFIG_NET_ICMPV4_LOG_LEVEL_DBG=y

CONFIG_BOOTLOADER_MCUBOOT=y

#
# overlay-prj.conf
#

#Example of product_uid, you must set you product uid.
CONFIG_UPDATEHUB_PRODUCT_UID="e4d37cfe6ec48a2d069cc0bbb8b078677e9a0d8df3a027c4d8ea131130c4265f"

#If you use the autorandler, need set UPDATEHUB_POLL_INTERVAL.
#This example, the updatehub will poll on the server
#request for updates one to one minute.
#(min: 0 minute, máx: 30 days)
CONFIG_UPDATEHUB_POLL_INTERVAL=1

CONFIG_UPDATEHUB_CE=y

#You need set the updatehub-ce ip Address.
#This is a example of ip address
CONFIG_UPDATEHUB_SERVER="192.168.55.155"

#
# prj.conf
#

# Copyright (c) 2018-2020 O.S.Systems
# SPDX-License-Identifier: Apache-2.0
CONFIG_FLASH=y
CONFIG_STREAM_FLASH=y
CONFIG_FLASH_MAP=y
CONFIG_REBOOT=y
CONFIG_MCUBOOT_IMG_MANAGER=y
CONFIG_IMG_MANAGER=y
CONFIG_IMG_ENABLE_IMAGE_CHECK=y
# CONFIG_BOOTLOADER_MCUBOOT=y  # duplicated
CONFIG_MPU_ALLOW_FLASH_WRITE=y
# CONFIG_NETWORKING=y  # duplicated
# CONFIG_NET_UDP=y  # duplicated
CONFIG_NET_SOCKETS=y
CONFIG_COAP=y
CONFIG_DNS_RESOLVER=y
CONFIG_JSON_LIBRARY=y
CONFIG_HWINFO=y
CONFIG_POSIX_API=y

# Turn on the updatehub
CONFIG_UPDATEHUB=y
CONFIG_COAP_INIT_ACK_TIMEOUT_MS=10000

# Heap mem pool size
CONFIG_HEAP_MEM_POOL_SIZE=8192
CONFIG_SYSTEM_WORKQUEUE_STACK_SIZE=8192

# Network events
# CONFIG_NET_CONNECTION_MANAGER=y  # duplicated
CONFIG_NET_CONFIG_SETTINGS=y

CONFIG_NET_IPV6=n

# CONFIG_NET_IPV4=y  # duplicated
# CONFIG_NET_DHCPV4=y  # duplicated

# Enable Shell
# CONFIG_SHELL=y  # duplicated
# CONFIG_SHELL_STACK_SIZE=8192  # duplicated
CONFIG_UPDATEHUB_SHELL=y
# CONFIG_NET_SHELL=y  # duplicated

# Debug helpers
# CONFIG_LOG=y  # duplicated
CONFIG_UPDATEHUB_LOG_LEVEL_DBG=y
# CONFIG_NET_LOG=y  # duplicated
# CONFIG_NET_DHCPV4_LOG_LEVEL_DBG=y  # duplicated
# CONFIG_NET_IPV4_LOG_LEVEL_DBG=y  # duplicated
# CONFIG_NET_ICMPV4_LOG_LEVEL_DBG=y  # duplicated

CONFIG_MAX_THREAD_BYTES=3

#
# overlay-wifi.conf
#

# Disable default configs
CONFIG_NET_L2_ETHERNET=n

# CONFIG_NET_DHCPV4=n  # commenting out because it conflicts with apsta settings

# CONFIG_NET_CONFIG_SETTINGS=n  # commenting out because it conflicts with apsta settings

# Enable WIFI
# CONFIG_WIFI=y
CONFIG_UPDATEHUB_SAMPLE_WIFI_SSID="My Wifi"
CONFIG_UPDATEHUB_SAMPLE_WIFI_PSK="G4JR2H98"

# CONFIG_NET_PKT_RX_COUNT=8  # duplicated
# CONFIG_NET_PKT_TX_COUNT=8  # duplicated
CONFIG_NET_BUF_RX_COUNT=20
CONFIG_NET_BUF_TX_COUNT=20

# Add DNS Server
CONFIG_DNS_SERVER_IP_ADDRESSES=y
CONFIG_DNS_SERVER1="8.8.8.8"
```

## src/main.c
```c
/*
 * Copyright (c) 2018-2023 O.S.Systems
 *
 * SPDX-License-Identifier: Apache-2.0
 */

#include <zephyr/kernel.h>
#include <zephyr/mgmt/updatehub.h>
#include <zephyr/net/net_mgmt.h>
#include <zephyr/net/net_event.h>
#include <zephyr/net/conn_mgr_monitor.h>
#include <zephyr/net/net_if.h>
#include <zephyr/net/net_core.h>

#ifdef CONFIG_NET_L2_WIFI_MGMT
#include <zephyr/net/wifi_mgmt.h>
#endif /* CONFIG_NET_L2_WIFI_MGMT */

#if defined(CONFIG_UPDATEHUB_DTLS)
#include <zephyr/net/tls_credentials.h>
#include "c_certificates.h"
#endif

#include <zephyr/logging/log.h>
LOG_MODULE_REGISTER(main);

void start_updatehub(void)
{
#if defined(CONFIG_UPDATEHUB_SAMPLE_POLLING)
    LOG_INF("Starting UpdateHub polling mode");
    updatehub_autohandler();
#endif

#if defined(CONFIG_UPDATEHUB_SAMPLE_MANUAL)
    LOG_INF("Starting UpdateHub manual mode");

    switch (updatehub_probe())
    {
    case UPDATEHUB_HAS_UPDATE:
        switch (updatehub_update())
        {
        case UPDATEHUB_OK:
            ret = 0;
            updatehub_reboot();
            break;

        default:
            LOG_ERR("Error installing update.");
            break;
        }

    case UPDATEHUB_NO_UPDATE:
        LOG_INF("No update found");
        ret = 0;
        break;

    default:
        LOG_ERR("Invalid response");
        break;
    }
#endif
}

#define NET_EVENT_WIFI_MASK (NET_EVENT_WIFI_CONNECT_RESULT | NET_EVENT_WIFI_DISCONNECT_RESULT)

/* STA Mode Configuration */
#define WIFI_SSID "My Wifi" /* Replace `SSID` with WiFi ssid. */
#define WIFI_PSK "G4JR2H98" /* Replace `PASSWORD` with Router password. */

static struct net_if *sta_iface;
static struct wifi_connect_req_params sta_config;
static struct net_mgmt_event_callback cb;

static void wifi_event_handler(struct net_mgmt_event_callback *cb, uint64_t mgmt_event,
                               struct net_if *iface)
{
    switch (mgmt_event)
    {
    case NET_EVENT_WIFI_CONNECT_RESULT:
    {
        LOG_INF("Connected to %s", WIFI_SSID);
        k_sleep(K_SECONDS(5));
        start_updatehub();
        break;
    }
    case NET_EVENT_WIFI_DISCONNECT_RESULT:
    {
        LOG_INF("Disconnected from %s", WIFI_SSID);
        break;
    }
    default:
        break;
    }
}

static int connect_to_wifi(void)
{
    if (!sta_iface)
    {
        LOG_INF("STA: interface not initialized");
        return -EIO;
    }

    sta_config.ssid = (const uint8_t *)WIFI_SSID;
    sta_config.ssid_length = strlen(WIFI_SSID);
    sta_config.psk = (const uint8_t *)WIFI_PSK;
    sta_config.psk_length = strlen(WIFI_PSK);
    sta_config.security = WIFI_SECURITY_TYPE_PSK;
    sta_config.channel = WIFI_CHANNEL_ANY;
    sta_config.band = WIFI_FREQ_BAND_2_4_GHZ;

    LOG_INF("Connecting to SSID: %s", sta_config.ssid);

    int ret = net_mgmt(NET_REQUEST_WIFI_CONNECT, sta_iface, &sta_config,
                       sizeof(struct wifi_connect_req_params));
    if (ret)
    {
        LOG_ERR("Unable to Connect to (%s)", WIFI_SSID);
    }

    return ret;
}

int main(void)
{
    /* The image of application needed be confirmed */
    LOG_INF("Confirming the boot image");
    int ret = updatehub_confirm();
    if (ret < 0)
    {
        LOG_ERR("Error to confirm the image");
    }

    k_sleep(K_SECONDS(5));

    net_mgmt_init_event_callback(&cb, wifi_event_handler, NET_EVENT_WIFI_MASK);
    net_mgmt_add_event_callback(&cb);

    /* Get STA interface */
    sta_iface = net_if_get_wifi_sta();

    connect_to_wifi();

    /* Wait forever */
    while (1)
    {
        LOG_DBG("Still alive");
        k_sleep(K_SECONDS(10));
    }

    return 0;
}
```
